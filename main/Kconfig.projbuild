## main/Kconfig.projbuild
```kconfig
choice SENSOR_TYPE
    prompt "Sensor type"
    default SENSOR_TYPE_SEN54

config SENSOR_TYPE_SEN54
    bool "SEN54"

config SENSOR_TYPE_MODBUS
    bool "Modbus RTU"

endchoice
```
